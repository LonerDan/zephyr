## soc/st/stm32/stm32f0x/Kconfig.defconfig.stm32f070x6
```kconfig
# ST Microelectronics STM32F070X6 MCU

# Copyright (c) 2018 qianfan Zhao
# SPDX-License-Identifier: Apache-2.0

if SOC_STM32F070X6

config NUM_IRQS
	default 32

endif # SOC_STM32F070X6
```
